## coredump/Kconfig
```kconfig
#
# For a description of the syntax of this configuration file,
# see the file kconfig-language.txt in the NuttX tools repository.
#

menuconfig PYXIS_COREDUMP
	tristate "Pyxis coredump"
	default n
	depends on ELF_COREDUMP
	---help---
```

## dumpnet/Kconfig
```kconfig
#
# For a description of the syntax of this configuration file,
# see the file kconfig-language.txt in the NuttX tools repository.
#

menuconfig PYXIS_DEBUG_DUMP_NET
	tristate "NET STAT dumper"
	default n
	depends on NET
	---help---
```

## fbdebug/Kconfig
```kconfig
#
# For a description of the syntax of this configuration file,
# see the file kconfig-language.txt in the NuttX tools repository.
#

menuconfig PYXIS_FBDEBUG
	tristate "Framebuffer Debug Tool"
	default n
	depends on VIDEO_FB
	depends on LIB_PNG
	select NETUTILS_CODECS
	select CODECS_BASE64
	---help---
		A simple tool for debugging system framebuffer.

if PYXIS_FBDEBUG

config PYXIS_FBDEBUG_STACKSIZE
	int "FBdebug stack size"
	default 4096
	---help---
		The stack size to use the fbdebug tool.

config PYXIS_FBDEBUG_PRIORITY
	int "FBdebug priority"
	default 100
	---help---
		The priority to use the fbdebug tool.

config PYXIS_FBDEBUG_SWAPRB
	bool "Swap R & B channel"
	default n

endif
```

## sysmon/Kconfig
```kconfig
#
# For a description of the syntax of this configuration file,
# see the file kconfig-language.txt in the NuttX tools repository.
#

menuconfig VELA_SYSMON
	tristate "System Monitor"
	default n
	depends on FS_PROCFS
	---help---
		This option will enable a system monitor daemon. This daemon
		will periodically collects diagnostics from procfs and outputs
		all-in-one periodically.

if VELA_SYSMON

config VELA_SYSMON_STACKSIZE
	int "system monitor stop/stop stack size"
	default DEFAULT_TASK_STACKSIZE
	---help---
		The stack size to use the sysmon_start/sysmon_stop task.  Default: 2048

config VELA_SYSMON_PRIORITY
	int "system monitor stop/stop priority"
	default 100
	---help---
		The priority to use the sysmon_start/sysmon_stop task.  Default: 100

config VELA_SYSMON_DAEMON_STACKSIZE
	int "system monitor daemon stack size"
	default DEFAULT_TASK_STACKSIZE
	---help---
		The stack size to use the system monitor daemon.  Default: 2048

config VELA_SYSMON_DAEMON_PRIORITY
	int "system monitor daemon priority"
	default 50
	---help---
		The priority to use the stack monitor daemon.  Default: 50

config VELA_SYSMON_INTERVAL
	int "system monitor dump frequency"
	default 2
	---help---
		The rate in seconds that the system monitor will wait before
		dumping the next set of information.  Default:  2 seconds.

config VELA_SYSMON_MOUNTPOINT
	string "procfs mountpoint"
	default "/proc"

endif
```
